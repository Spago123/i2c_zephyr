## CMakeLists.txt
```
# SPDX-License-Identifier: Apache-2.0

cmake_minimum_required(VERSION 3.20.0)
find_package(Zephyr REQUIRED HINTS $ENV{ZEPHYR_BASE})
project(i2c_lcd)

target_sources(app PRIVATE 
    src/main.c
    inc/i2c_lcd.c
)
```

## sample.yaml
```
sample:
  name: i2c
```

## prj.conf
```kconfig
CONFIG_PRINTK=y
CONFIG_HEAP_MEM_POOL_SIZE=256
CONFIG_GPIO=y
CONFIG_I2C=y
```

## app.overlay
```dts
/{
    aliases {
        led0 = &green_led_7;
        led1 = &blue_led_9;
        led2 = &red_led_3;
        led7 = &orange_led_5;
    };
};
```

## src/main.c
```c
/*
 * Copyright (c) 2016 Intel Corporation
 *
 * SPDX-License-Identifier: Apache-2.0
 */

#include <stdbool.h>
#include <zephyr/kernel.h>
#include <zephyr/device.h>
#include <zephyr/drivers/gpio.h>
#include <zephyr/sys/printk.h>
#include <string.h>
#include <zephyr/drivers/i2c.h>
#include "../inc/i2c_lcd.h"

#define I2C_INST DT_NODELABEL(i2c1)

const struct device *const i2c = DEVICE_DT_GET(I2C_INST);

int main(){
	if (!device_is_ready(i2c)) {
		printf("i2c is not ready!\n");
	} else {
		printf("i2c is ready\n");
	}
	lcdInit(i2c);
	k_sleep(K_MSEC(1000));
	const char buf[] = "hello";
	lcdSendString(i2c, buf);
	while (1){
		printk("Hello world\n");
	}
	return 0;
}
```

## inc/click_detection.h
```c
/**
 * @file click_detection.h
 * @author Harun Špago (hspago@prosafety.ba)
 * @brief 
 * @version 0.1
 * @date 2024-03-18
 * 
 * @copyright Copyright (c) 2024
 * 
 */
#ifndef CLICK_DETECTION_H
#define CLICK_DETECTION_H

#include <stdbool.h>

#define LOWER_NOISE 10
#define UPPER_NOISE 300
#define SHORT_LONG_CLICK_TRESHOLD 80
#define SHORT_CLICK_TIME_OUT 50


typedef enum{
    NOISE,
    CLICK,
    STAGE,
} ClickStates;

typedef enum{
    INITIAL,
    ONE_CLICK,
    DOUBLE_CLICK,
    TRIPLE_CLICK,
    LONG_CLICK
} ClickTypes;

typedef struct{
    unsigned int time_pressed;
    unsigned int time_released;
    unsigned char click_counter;
    ClickStates state;
} ClickData;

/**
 * @brief Function used to init the  click detection module.
 * 
 * @return ClickData 
 */
ClickData initClickDetection(void);
/**
 * @brief Function used to reset the time_pressed for the HIGH state of the gpio pin
 * 
 * @param click_data 
 */
void risingEdge(ClickData *click_data);
/**
 * @brief Function used to reset the time_relased for the LOW state of the gpio pin
 * 
 * @param click_data 
 */
void fallingEdge(ClickData *click_data);
/**
 * @brief Function used to increment the time pressed, aka the time the gpio pin is in the HIGH state
 * 
 * @param click_data 
 */
void incrementPressedTime(ClickData *click_data);
/**
 * @brief Function used to increment the time relased, aka the time the gpio pin is in LOW state
 * 
 * @param click_data 
 */
void incrementReleasedTime(ClickData *click_data);
/**
 * @brief Function used to procceses the current pin state and the previous informations and
 * change the informations of the click_data and return the detected click state
 * 
 * @param click_data 
 * @param curr_pin_state current state of the pin, bool
 * @return ClickTypes 
 */
ClickTypes proccesClickData(ClickData *click_data, bool curr_pin_state);


#endif // CLICK_DETECTION_H
```

## inc/i2c_lcd.c
```c
#include "i2c_lcd.h"
#include <zephyr/sys/printk.h>


// LOG_MODULE_REGISTER(i2c_lcd);

#define SLAVE_ADDRESS_LCD 0x4E


void lcdSendCommand(const struct device *const i2c_dev, char cmd){
    char data_u, data_l;
	uint8_t data_t[4];
	data_u = (cmd & 0xf0);
	data_l = ((cmd << 4) & 0xf0);
	data_t[0] = data_u | 0x0C;  // en=1, rs=0
	data_t[1] = data_u | 0x08;  // en=0, rs=0
	data_t[2] = data_l | 0x0C;  // en=1, rs=0
	data_t[3] = data_l | 0x08;  // en=0, rs=0
	int ret;
	ret = i2c_write(i2c_dev, data_t, 4, SLAVE_ADDRESS_LCD);
	printk("Status %d\n", ret);
}

void lcdSendData(const struct device *const i2c_dev, char data){
    char data_u, data_l;
	uint8_t data_t[4];
	data_u = (data & 0xf0);
	data_l = ((data << 4) & 0xf0);
	data_t[0] = data_u | 0x0D;  // en=1, rs=0
	data_t[1] = data_u | 0x09;  // en=0, rs=0
	data_t[2] = data_l | 0x0D;  // en=1, rs=0
	data_t[3] = data_l | 0x09;  // en=0, rs=0
	i2c_write(i2c_dev, data_t, 4, SLAVE_ADDRESS_LCD);
}

void lcdClear(const struct device *const i2c_dev){
	lcdSendCommand(i2c_dev, 0x80);
	for (int i = 0; i < 70; i++)
	{
		lcdSendData(i2c_dev, ' ');
	}
}

void lcdPutCur(const struct device *const i2c_dev, int row, int col){
    switch (row){
        case 0:
            col |= 0x80;
            break;
        case 1:
            col |= 0xC0;
            break;
    }

    lcdSendCommand(i2c_dev, col);
}

void lcdInit (const struct device *const i2c_dev){
	// 4 bit initialization
	k_sleep(K_MSEC(50));  // wait for >40ms
	lcdSendCommand(i2c_dev, 0x30);
	k_sleep(K_MSEC(5));  // wait for >4.1ms
	lcdSendCommand(i2c_dev, 0x30);
	k_sleep(K_USEC(100));  // wait for >100us
	lcdSendCommand(i2c_dev, 0x30);
	k_sleep(K_MSEC(10));
	lcdSendCommand(i2c_dev, 0x20);  // 4bit mode
	k_sleep(K_MSEC(10));

  // display initialization
	lcdSendCommand(i2c_dev, 0x28); // Function set --> DL=0 (4 bit mode), N = 1 (2 line display) F = 0 (5x8 characters)
	k_sleep(K_MSEC(1));
	lcdSendCommand(i2c_dev, 0x08); // Display on/off control --> D=0,C=0, B=0  ---> display off
	k_sleep(K_MSEC(1));
	lcdSendCommand(i2c_dev, 0x01);  // clear display
	k_sleep(K_MSEC(1));
	k_sleep(K_MSEC(1));
	lcdSendCommand(i2c_dev, 0x06); // Entry mode set --> I/D = 1 (increment cursor) & S = 0 (no shift)
	k_sleep(K_MSEC(1));
	lcdSendCommand(i2c_dev, 0x0C); // Display on/off control --> D = 1, C and B = 0. (Cursor and blink, last two bits)
}

void lcdSendString(const struct device *const i2c_dev, char *str){
	while (*str) 
        lcdSendData(i2c_dev, *str++);
}
```

## inc/i2c_lcd.h
```c
/**
 * @file click_detection.h
 * @author Harun Špago (hspago@prosafety.ba)
 * @brief 
 * @version 0.1
 * @date 2024-03-18
 * 
 * @copyright Copyright (c) 2024
 * 
 */
#ifndef I2C_LCD_H
#define I2C_LCD_H

#include <zephyr/drivers/i2c.h>
#include <zephyr/logging/log.h>

#define SLAVE_ADDRESS_LCD 0x4E

/**
 * @brief Send a command to the LCD.
 *
 * @param i2c_dev Pointer to the I2C device.
 * @param cmd Command byte to send.
 */
void lcdSendCommand(const struct device *const i2c_dev, char cmd);

/**
 * @brief Send data to the LCD.
 *
 * @param i2c_dev Pointer to the I2C device.
 * @param data Data byte to send.
 */
void lcdSendData(const struct device *const i2c_dev, char data);

/**
 * @brief Clear the LCD display.
 *
 * @param i2c_dev Pointer to the I2C device.
 */
void lcdClear(const struct device *const i2c_dev);

/**
 * @brief Set the cursor position on the LCD.
 *
 * @param i2c_dev Pointer to the I2C device.
 * @param row Row number (0 or 1).
 * @param col Column number.
 */
void lcdPutCur(const struct device *const i2c_dev, int row, int col);

/**
 * @brief Initialize the LCD.
 *
 * @param i2c_dev Pointer to the I2C device.
 */
void lcdInit(const struct device *const i2c_dev);

/**
 * @brief Send a string to the LCD.
 *
 * @param i2c_dev Pointer to the I2C device.
 * @param str Null-terminated string to send.
 */
void lcdSendString(const struct device *const i2c_dev, char *str);

#endif // I2C_LCD_H
```

## inc/sequence_impl.h
```c
/**
 * @file sequence_impl.h
 * @author Harun Špago (hspago@prosafety.ba)
 * @brief 
 * @version 0.1
 * @date 2024-03-18
 * 
 * @copyright Copyright (c) 2024
 * 
 */
#ifndef SEQUENCE_IMPL_H
#define SEQUENCE_IMPL_H

#include "click_detection.h"

#define TIMER_OVERFLOW 10 // in milli seconds
#define MAXIMUM 10

typedef enum{
    SLOW, 
    FAST
} Speed;

typedef enum{
    FORWARD, 
    REVERSE
} Direction;

typedef enum{
    RESUME,
    PAUSED
} SequenceState;

typedef struct {
    int timer;
    int curr_transition;
    int num_of_transitions;
    Speed speed;
    Direction direction;
	int overflows[MAXIMUM];
    int orange_pin_state[MAXIMUM];
    int red_pin_state[MAXIMUM];
    int green_pin_state[MAXIMUM];
    int blue_pin_state[MAXIMUM];
} Sequence;

typedef struct {
    Sequence sequences[MAXIMUM];
    int curr_sequence;
    int num_of_sequences;
    SequenceState state; 
} FlashingSequences;

void flashSequence(Sequence* sequence);

void sequenceFSM(FlashingSequences* flashing_sequences, ClickTypes click_types);

void resetSequence(Sequence* sequence);

void changeSpeed(Sequence* sequence);

void doTransition(FlashingSequences* flashing_sequences);

void changeSequenceDirection(Sequence *sequence);

#endif // SEQUENCE_IMPL_H
```

## src/click_detection.c
```c
#include "../inc/click_detection.h"


ClickData initClickDetection(void){
    return  (ClickData) {0, 0, 0, NOISE};
}

void risingEdge(ClickData *click_data){
    click_data->time_pressed = 0; // Reset time pressed to zero if it's a new button press
}

void fallingEdge(ClickData *click_data){
    click_data->time_released = 0;
}

void incrementPressedTime(ClickData *click_data){
    click_data->time_pressed++;
}
void incrementReleasedTime(ClickData *click_data){
    click_data->time_released++;
}

static bool checkShortClickConditions(unsigned int time_pressed){
    return time_pressed > LOWER_NOISE && time_pressed <= SHORT_LONG_CLICK_TRESHOLD;
}

static bool checkLongClickConditions(unsigned int time_pressed){
    return time_pressed > SHORT_LONG_CLICK_TRESHOLD && time_pressed <= UPPER_NOISE;
}

ClickTypes proccesClickData(ClickData *click_data, bool curr_pin_state){
    switch (click_data->state){
        case NOISE:{
            if (click_data->time_pressed > LOWER_NOISE && curr_pin_state){
                click_data->state = CLICK;
                return INITIAL;
            } else if(click_data->time_pressed <= LOWER_NOISE && !curr_pin_state){ // NOISE
                *click_data = initClickDetection();
                return INITIAL;
            }
            break;
        }
        case CLICK:{
            if(checkShortClickConditions(click_data->time_pressed) && !curr_pin_state){ // DETECTED A SHORT CLICK
                click_data->state = STAGE; 
                click_data->click_counter++;
                return INITIAL;
            } else if(checkLongClickConditions(click_data->time_pressed) && !curr_pin_state){ // LONG CLICK DETECTED
                *click_data = initClickDetection();
                return LONG_CLICK;
            } else if(click_data->time_pressed > UPPER_NOISE && !curr_pin_state){ // CONSIDER NOISE
                *click_data = initClickDetection();
                return INITIAL;
            }
            break;
        }
        case STAGE:{
            if (click_data->time_released > SHORT_CLICK_TIME_OUT && !curr_pin_state) {
                if(click_data->click_counter == 1) {
                    *click_data = initClickDetection();
                    return ONE_CLICK;
                } else if(click_data->click_counter == 2) {
                    *click_data = initClickDetection();
                    return DOUBLE_CLICK;
                } else if(click_data->click_counter == 3){
                    *click_data = initClickDetection();
                    return TRIPLE_CLICK;
                } else{
                    *click_data = initClickDetection(); 
                    return INITIAL;
                }
            } else if(click_data->time_released <= SHORT_CLICK_TIME_OUT && curr_pin_state){
                click_data->state = CLICK;
                return INITIAL;
            }
            break;
        }
    }
    return INITIAL;
}
```

## src/sequence_impl.c
```c
#include "../inc/sequence_impl.h"

void flashSequence(Sequence* sequence){
    if(sequence->timer >=             // SLOW                                               // FAST
    ((sequence->speed == SLOW) ? sequence->overflows[sequence->curr_transition] : sequence->overflows[sequence->curr_transition] / 2)){
        sequence->timer = 0;
        if(sequence->direction == REVERSE && sequence->curr_transition == 0) {
            sequence->curr_transition = sequence->num_of_transitions - 1;
        }else if(sequence->direction == FORWARD && sequence->curr_transition == sequence->num_of_transitions - 1){
            sequence->curr_transition = 0;
        }else {
            sequence->curr_transition = (sequence->direction == FORWARD) ? (sequence->curr_transition + 1) : (sequence->curr_transition - 1);
        }
    }
}

void changeSequenceDirection(Sequence *sequence){
    switch (sequence->direction) {
        case FORWARD:
            sequence->direction = REVERSE;
            break;
        case REVERSE:
            sequence->direction = FORWARD;
            break;
    }
}

void resetSequence(Sequence* sequence){
    sequence->timer = 0;
    sequence->speed = SLOW;
    sequence->direction = FORWARD;
    sequence->curr_transition = 0;
}

void changeSpeed(Sequence* sequence){
    if(sequence->speed == SLOW){
        sequence->speed = FAST;
    } else{
        sequence->speed = SLOW;
    }
}

void doTransition(FlashingSequences* flashing_sequences){
    if(flashing_sequences->curr_sequence == flashing_sequences->num_of_sequences - 1){
        flashing_sequences->curr_sequence = 0;
    } else{
        flashing_sequences->curr_sequence++;
    }
}

void sequenceFSM(FlashingSequences* flashing_sequences, ClickTypes click_types){
    switch (click_types){
        case INITIAL:{
            if (flashing_sequences->state == RESUME){
                flashSequence(&flashing_sequences->sequences[flashing_sequences->curr_sequence]);
            }
            break;
        }
        case ONE_CLICK:{
			if(flashing_sequences->state == RESUME){
				doTransition(flashing_sequences);
			    flashSequence(&flashing_sequences->sequences[flashing_sequences->curr_sequence]);
			}
            break;
        }
		case DOUBLE_CLICK:{
			if(flashing_sequences->state == RESUME){
				changeSpeed(&flashing_sequences->sequences[flashing_sequences->curr_sequence]);
				flashSequence(&flashing_sequences->sequences[flashing_sequences->curr_sequence]);
			}
            break;
		}
        case TRIPLE_CLICK:{
            if(flashing_sequences->state == RESUME){
                changeSequenceDirection(&flashing_sequences->sequences[flashing_sequences->curr_sequence]);
                flashSequence(&flashing_sequences->sequences[flashing_sequences->curr_sequence]);
            }
            break;
        }
		case LONG_CLICK:{
			if(flashing_sequences->state == RESUME){
				flashing_sequences->state = PAUSED;
			}else {
				flashing_sequences->state = RESUME;
			}
            break;
		}
    }
}
```
